## holos/buildroot-packages/holos-config/Config.in
```kconfig
    config BR2_PACKAGE_HOLOS_CONFIG
        bool "holos-config"
        help
            A tool for installing, configuring and managing HolOS systems.
```

## holos/buildroot-packages/sysbox-runtime/Config.in
```kconfig
    config BR2_PACKAGE_SYSBOX_RUNTIME
        bool "sysbox-runtime"
        help
            A library-OS container runtime, compatible with OCI container managers.
```
